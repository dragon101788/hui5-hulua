## Kconfig
```kconfig
mainmenu "HUI Configuretion"


comment "------------HUI Configuretion---------"

config  USING_FONT
        bool "Using TTF Font"

choice 
        prompt "alpha channel render"
        default ALPHA_SOFT
        help
		select alpha channel render
config ALPHA_SOFT
        bool "Soft Alpha"
        help
		soft
config ALPHA_BLT
        bool "Nuvoton 2D Blitting Accelerator"
        help
		2d Bltting
endchoice

config  FB_SOFT_RGB565
        bool "FrameBuffer Soft Rgb565 output"
choice 
        prompt "Touch Panel Device"
        default TOUCH_NONE
        help
		select alpha channel render
config TOUCH_NONE
        bool "none"
        help
		soft
config TOUCH_EKTF2K
        bool "ektf2k"
        help
		2d Bltting
endchoice

choice 
        prompt "readonly resource manager"
        default RESOURCE_RUNTIME_DECODER
        help
			readonly resource manager

config  RESOURCE_RUNTIME_DECODER
        bool "runtime decoder"
        help
		old meth runtime decoder image
		[Minimum  disk use]
		[decode each]
config  RESOURCE_RUNTIME_INDEX
        bool "runtime index"
        help
		mmap meth index virtual memory
		[Minimum  memory use]
		[decode once]
config  RESOURCE_RUNTIME_FETCH
        bool "runtime fetch"
        help
		[decode once]
endchoice

menu "hui debug option"
config DEBUG
	bool "enable debug"

config LOG_D
	bool "enable log_d"
config LOG_I
	bool "enable log_i"
config LOG_W
	bool "enable log_w"
config LOG_E
	bool "enable log_e"

config DUMPSTACK_DEBUG
	bool "enable DUMPSTACK_DEBUG"
	help 
		"with arm uclibc platfrom use this"
endmenu

comment "------------Dragon Auto Configuretion---------"
source Kconfig.auto
```

## drawlogic/Kconfig.in
```kconfig
choice 
        prompt "draw logic"
        default DRAWLOGIC_BFQ
        help
			readonly resource manager

config  DRAWLOGIC_BFQ
        bool "BFQ begin after queue >dragon"
        help
			BFQ
config  DRAWLOGIC_TT
        bool "render by orders >TT"
        help
			send caveguy@qq.com for detail
config  DRAWLOGIC_NONE
        bool "none"
        help
			???
endchoice
```

## mres/Kconfig.in
```kconfig
choice 
        prompt "readonly resource manager"
        default RESOURCE_RUNTIME_DECODER
        help
			readonly resource manager

config  RESOURCE_RUNTIME_DECODER
        bool "runtime decoder"
        help
		old meth runtime decoder image
		[Minimum  disk use]
		[decode each]
config  RESOURCE_RUNTIME_INDEX
        bool "runtime index"
        help
		mmap meth index virtual memory
		[Minimum  memory use]
		[decode once]
config  RESOURCE_RUNTIME_FETCH
        bool "runtime fetch"
        help
		[decode once]
endchoice
```

## widget/button/Kconfig.in
```kconfig
config  CONTROL_BUTTON 
        bool "button Control" 
        help 
			path=$AUTOPATH
			<button name="jc" x="360" y="16" width="120" height="120" lay="2">
				<up>res/jc1.png</up>
				<dn>res/jc2.png</dn>
				<res meth="text" name="up" red="255" green="255" blue="255" dst_x="25" dst_y="80" font="song" size="18" txt="辅助调平"/>
				<res meth="text" name="dn" red="255" green="255" blue="255" dst_x="25" dst_y="80" font="song" size="18" txt="辅助调平"/>
			</button>
```

## widget/cartoon/Kconfig.in
```kconfig
config  CONTROL_CARTOON 
        bool "cartoon Control" 
        help 
			path=$AUTOPATH
```

## widget/dragframe/Kconfig.in
```kconfig
config  CONTROL_DRAG_FRAME 
        bool "drag_frame Control" 
        help 
			path=$AUTOPATH
			<dragframe name="frame" x="0" y="16" width="480" height="240" lay="1" x_lock="1">
				  <![CDATA[
						ls_dir("/mnt/sdcard/3D");
				   ]]>
				<static_image name="jct" x="200" y="30" width="46" height="36" lay="2">
						<node>res/jct(r).png</node>
				</static_image>
				...
				...
			</dragframe>
```

## widget/hu/drag_menu/Kconfig.in
```kconfig
config  CONTROL_DRAG_MENU 
        bool "drag_menu Control" 
        help 
			path=$AUTOPATH
 
```

## widget/hu/gesture/Kconfig.in
```kconfig
config  CONTROL_GESTURE 
        bool "gesture Control" 
		help 
			path=$AUTOPATH
```

## widget/lgf/lgf_button/Kconfig.in
```kconfig
config  CONTROL_LGF_BUTTON 
        bool "lgf_button Control" 
        help 
			path=$AUTOPATH
```

## widget/luo/lj_drag_image/Kconfig.in
```kconfig
config  CONTROL_LJ_DRAG_IMAGE 
      	bool "lj_drag_image Control" 
        help 
		path=$AUTOPATH
```

## widget/luo/lj_drag_vertical_explain/Kconfig.in
```kconfig
config  CONTROL_LJ_DRAG_VERTICAL_EXPLAIN 
        bool "lj_drag_vertical_explain Control" 
        help 
        <lj_drag_vertical_explain name=explain x=30 y=40 width="240" height="170" >
    			<img>main/TEXT1.png</img>
    		</lj_drag_vertical_explain>
			path=$AUTOPATH
```

## widget/luo/lj_lock/Kconfig.in
```kconfig
config  CONTROL_LJ_LOCK 
        bool "lj_lock Control" 
        help 
		path=$AUTOPATH
```

## widget/luo/lj_screensaver/Kconfig.in
```kconfig
config  CONTROL_LJ_SCREENSAVER
        bool "lj_screensaver Control" 
        help 
        	<screensaver ptimer=5000 run='./tongs_pre.sh'/>
        	wait 5 sec into tongs_pre.sh seript
			path=$AUTOPATH
```

## widget/radio_bottons/Kconfig.in
```kconfig
config  CONTROL_RADIO_BUTTONS 
        bool "Radig Buttons Control" 
        help 
	<Radio_buttons name="xzrf" select="4rf">
	    <node name="1rf" x="22"   y="54"  width="112" height="51" var="0" cs="fl1">
	    	<up>button/1-1.png</up>
	    	<dn>button/1-2.png</dn>
	    </node>
	    <node name="2rf" x="134"   y="54"  width="109" height="51" var="1" cs="fl2">
	    	<up>button/2-1.png</up>
	    	<dn>button/2-2.png</dn>
	    </node>
	    <node name="3rf" x="243"   y="54" width="109" height="51" var="2" cs="fl3">
	    	<up>button/3-1.png</up>
	    	<dn>button/3-2.png</dn>
	    </node>
	    <node name="4rf" x="352"   y="54"  width="112" height="51" var="3" cs="fl4">
	    	<up>button/4-1.png</up>
	    	<dn>button/4-2.png</dn>
	    </node>
    	</Radio_buttons>
			path=$AUTOPATH
```

## widget/static_image/Kconfig.in
```kconfig
config  CONTROL_STATIC_IMAGE 
        bool "static_image Control" 
        help 
			path=$AUTOPATH
			<static_image name="bk" x="0" y="0" width="480" height="272" lay="0">
					<node>res/bk.png</node>
			</static_image>
```

## widget/static_text/Kconfig.in
```kconfig
config  CONTROL_STATIC_TEXT 
        depends on USING_FONT 
        bool "static_text Control" 
        help 
			path=$AUTOPATH
			<static_text name="ttt" width="300" height="50"  x="150" y="100" padding_left=3 padding_top=0 align_center=1 red="255" blue="255" green="255" txt="扫描SD中.." size="20" font="song"  lay="11"/> 

            
```

## widget/zhang/slip_menu/Kconfig.in
```kconfig
config  CONTROL_SLIP_MENU 
        bool "slip_menu Control" 
        help 
			path=$AUTOPATH
```

## widget/zhang/slip_text/Kconfig.in
```kconfig
config  CONTROL_SLIP_TEXT 
        bool "slip_text Control" 
        help 
			path=$AUTOPATH
```
